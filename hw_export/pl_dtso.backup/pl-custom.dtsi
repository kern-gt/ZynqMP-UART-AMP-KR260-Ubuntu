/*
 * CAUTION: This file is automatically generated by Xilinx.
 * Version: XSCT 2024.1.1
 * Today is: Tue Jul 30 03:06:34 2024
 */


/ {
};

&axi_gpio_0 {
    status = "disabled";
};

&axi_gpio_1 {
    status = "disabled";
};

&axi_uartlite_3 {
    status = "disabled";
};

&axi_uartlite_4 {
    status = "disabled";
};